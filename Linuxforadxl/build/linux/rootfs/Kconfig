## Linuxforadxl/build/linux/rootfs/Kconfig
```kconfig
mainmenu "linux/rootfs Configuration"
config ARCH_ARM
	bool
	default y
menu "Filesystem Packages"
source /opt/PetaLinux/petalinux-v2014.2-final/components/packages-repo/Kconfig.defaults
if ROOTFS_ADVANCED_MODE
choice
	prompt "packages-repo"
config ROOTFS_COMPONENT_PACKAGES__REPO_NAME_PLNX__REPO
	bool "plnx-repo"
endchoice
if ROOTFS_COMPONENT_PACKAGES__REPO_NAME_PLNX__REPO
source /opt/PetaLinux/petalinux-v2014.2-final/components//packages-repo/plnx-repo//Kconfig
endif
endif
if !ROOTFS_ADVANCED_MODE
config ROOTFS_COMPONENT_PACKAGES__REPO_NAME_PLNX__REPO
	bool
	default y
source /opt/PetaLinux/petalinux-v2014.2-final/components/packages-repo/plnx-repo/Kconfig
endif
endmenu
menu "Libs"
endmenu
menu "Apps"
menuconfig ROOTFS_COMPONENT_APPS_NAME_ADXL362
	bool "adxl362"
source /home/kartha/Avnet-Digilent-ZedBoard-2014.2/components//apps/adxl362//Kconfig
menuconfig ROOTFS_COMPONENT_APPS_NAME_ADXL362SERVER
	bool "adxl362server"
source /home/kartha/Avnet-Digilent-ZedBoard-2014.2/components//apps/adxl362server//Kconfig
menuconfig ROOTFS_COMPONENT_APPS_NAME_CONFIGIP
	bool "configip"
source /home/kartha/Avnet-Digilent-ZedBoard-2014.2/components//apps/configip//Kconfig
menuconfig ROOTFS_COMPONENT_APPS_NAME_FWUPGRADE
	bool "fwupgrade"
source /opt/PetaLinux/petalinux-v2014.2-final/components//apps/fwupgrade//Kconfig
menuconfig ROOTFS_COMPONENT_APPS_NAME_GPIO__DEMO
	bool "gpio-demo"
source /opt/PetaLinux/petalinux-v2014.2-final/components//apps/gpio-demo//Kconfig
menuconfig ROOTFS_COMPONENT_APPS_NAME_LATENCYSTAT
	bool "latencystat"
source /opt/PetaLinux/petalinux-v2014.2-final/components//apps/latencystat//Kconfig
menuconfig ROOTFS_COMPONENT_APPS_NAME_PEEKPOKE
	bool "peekpoke"
source /opt/PetaLinux/petalinux-v2014.2-final/components//apps/peekpoke//Kconfig
menuconfig ROOTFS_COMPONENT_APPS_NAME_UWEB
	bool "uWeb"
source /opt/PetaLinux/petalinux-v2014.2-final/components//apps/uWeb//Kconfig
endmenu
menu "Modules"
endmenu
menu "PetaLinux RootFS Settings"
config ROOTFS_ROOT_PASSWD
	string "Root password"
	default ""
	help
	  Default login password for the 'root' user, on your PetaLinux system.

comment "Service configuration"
config ROOTFS_BUSYBOX_INETD_FTPD
	bool "Enable busybox FTPD with inetd service"
	select ROOTFS_PACKAGES_BUSYBOX_INETD
	default 'y'
	help
	 Select this option to enable busybox ftpd with inetd service and
	 run it on startup.

config ROOTFS_BUSYBOX_INETD_TELNETD
	bool "Enable busybox TELNETD with inetd service"
	select ROOTFS_PACKAGES_BUSYBOX_INETD
	default 'y'
	help
	 Select this option to enable busybox telnetd with inetd
	 service and run it on startup.
endmenu

#############################################################################

menu "Debugging"

config USER_DEBUG
	bool "build debugable applications"
	help
	 Build all user application with debug symbols and reduced optimisation
	 levels.  See also debug build option in force library building.  Withou
	 this option debug symbols are still included, however the optimisation
	 level is increased and this can lead to problematic debugging.

endmenu
```
